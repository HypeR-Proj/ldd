## Kconfig
```kconfig
# SPDX-FileCopyrightText: 2026 roolrz
# SPDX-License-Identifier: Apache-2.0

config SYSTEM_APP_LDD
    bool "ldd (/bin/ldd)"
    default y
    help
        Build and deploy hyper-ldd at /bin/ldd.
```
